## yocto/meta-linux-fpga-robot/conf/layer.conf
```bitbake
# meta-linux-fpga-robot layer

BBPATH .= ":${LAYERDIR}"

BBFILES += "${LAYERDIR}/recipes-*/*/*.bb \
            ${LAYERDIR}/recipes-*/*/*.bbappend"

BBFILE_COLLECTIONS += "linux-fpga-robot"
BBFILE_PATTERN_linux-fpga-robot = "^${LAYERDIR}/"
BBFILE_PRIORITY_linux-fpga-robot = "6"

LAYERSERIES_COMPAT_linux-fpga-robot = "scarthgap"
```

## yocto/meta-linux-fpga-robot/conf/machine/arty-z7-20-sdt.conf
```bitbake
#@TYPE: Machine
#@NAME: arty-z7-20-sdt
#@DESCRIPTION: Machine configuration for Digilent Arty Z7-20 using AMD EDF SDT flow.

require conf/machine/zynq-zc702-sdt-full.conf

# Use locally generated Arty Z7-20 SDT artifacts instead of inherited ZC702 SDT.
SDT_URI = "file://arty-z7-20-sdt.tar.gz"
SDT_URI[sha256sum] = "bd8b83e9daab46b8e3161b08922bf9adcd8ca94d7e329f9257561209edecb11c"
SDT_URI[S] = "${WORKDIR}/arty-z7-20-sdt"

# Use Arty Z7-20 Linux device-tree wrapper instead of inherited ZC702 wrapper.
CONFIG_DTFILE_DIR := "${@bb.utils.which(d.getVar('BBPATH'), 'conf/dts/arty-z7-20-sdt')}"
CONFIG_DTFILE = "${CONFIG_DTFILE_DIR}/cortexa9-linux.dts"

# Remove inherited ZC702 extra device-tree include.
EXTRA_DT_INCLUDE_FILES:remove = "zynq-zc702-sdt-full-system-conf.dtsi"

# Add Arty Z7-20 extra device-tree include.
EXTRA_DT_INCLUDE_FILES:append = " arty-z7-20-sdt-system-conf.dtsi"

# Use Arty-specific standalone/libxil config instead of inherited ZC702 config.
LIBXIL_CONFIG = "conf/machine/include/arty-z7-20-sdt/arty-z7-20-sdt-cortexa9-fsbl-libxil.conf"

# Arty Z7-20 has 512 MB DDR. Match QEMU memory to the board,
# not the inherited ZC702 1 GB setting.
QB_MEM = "-m 512"
```
